/*
  * Device tree overlay for AXI Timer peripheral in Zynq-7000 SoC PL section
  * Written by Tusori Tibor
  */
/dts-v1/;
/plugin/;

/{
	compatible =  "xlnx,zynq-7000";
	

	fragment@0{
		target=<&amba_pl>;
		#address-cells = <1>;
		#size-cells = <1>;
		__overlay__{

			pwm: pwm@43c10000 {
				compatible="xlnx,my-axi-pwm-1.0";
				reg=<0x43c10000 0x10000>;											
			};/*pwm*/


		}; /*overlay*/
	}; /*fragment*/
};
	
			